## boot/zephyr/boards/hpm6750evk2.conf
```kconfig
# MCUBoot settings
CONFIG_BOOT_MAX_IMG_SECTORS=512

CONFIG_BOOT_SIGNATURE_TYPE_NONE=y

CONFIG_BOOT_SIGNATURE_TYPE_RSA=n
```

## boot/zephyr/boards/hpm6800evk.conf
```kconfig
# MCUBoot settings
CONFIG_BOOT_MAX_IMG_SECTORS=512

CONFIG_DCACHE=n

CONFIG_ICACHE=n

CONFIG_BOOT_SIGNATURE_TYPE_NONE=y

CONFIG_BOOT_SIGNATURE_TYPE_RSA=n
```
